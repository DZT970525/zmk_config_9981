## config/west.yml
```yaml
manifest:
  remotes:
    - name: DZT970525
      url-base: https://github.com/DZT970525
  projects:
    - name: zmk
      remote: DZT970525
      revision: main
  self:
    path: config
```
